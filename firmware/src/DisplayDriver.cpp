#include "DisplayDriver.h"

#include <algorithm>

namespace {
constexpr int LcdCs = 10;
constexpr int LcdClock = 12;
constexpr int LcdData0 = 11;
constexpr int LcdData1 = 13;
constexpr int LcdData2 = 14;
constexpr int LcdData3 = 9;
constexpr int LcdBacklight = 41;

constexpr int PanelWidth = 320;
constexpr int PanelHeight = 480;
constexpr int TransferColumns = 48;

// Format: command, data length, delay in milliseconds, data bytes.
// Vendor sequence for the QDTech/LCDWiki ES3C35P ST77922 panel.
const uint8_t PanelInit[] = {
    0xF1, 1, 0, 0x00,
    0x60, 3, 0, 0x00, 0x00, 0x00,
    0x65, 1, 0, 0x80,
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    0x35, 1, 20, 0x01,
};
}

DisplayDriver displayDriver;

bool DisplayDriver::begin()
{
    setBacklight(true);

    _bus = new Arduino_ESP32QSPI(
        LcdCs, LcdClock, LcdData0, LcdData1, LcdData2, LcdData3);
    if (!_bus || !_bus->begin(40000000))
    {
        return false;
    }

    initializePanel();

    _canvas = new Arduino_Canvas(Width, Height, nullptr);
    if (!_canvas || !_canvas->begin(GFX_SKIP_OUTPUT_BEGIN))
    {
        return false;
    }

    _transferBuffer = static_cast<uint16_t*>(
        heap_caps_malloc(
            PanelWidth * TransferColumns * sizeof(uint16_t),
            MALLOC_CAP_DMA | MALLOC_CAP_8BIT));

    return _transferBuffer != nullptr;
}

void DisplayDriver::setBacklight(bool enabled)
{
    pinMode(LcdBacklight, OUTPUT);
    digitalWrite(LcdBacklight, enabled ? HIGH : LOW);
}

void DisplayDriver::sendCommand(
    uint8_t command,
    const uint8_t* data,
    uint8_t length)
{
    if (length == 0)
    {
        _bus->sendCommand(command);
        return;
    }

    _bus->writeC8Bytes(
        command,
        const_cast<uint8_t*>(data),
        length);
}

void DisplayDriver::initializePanel()
{
    _bus->sendCommand(0x01);
    delay(120);

    const uint8_t madctl = 0x00;
    const uint8_t colorMode = 0x55;
    sendCommand(0x36, &madctl, 1);
    sendCommand(0x3A, &colorMode, 1);

    const uint8_t* cursor = PanelInit;
    const uint8_t* end = PanelInit + sizeof(PanelInit);
    while (cursor < end)
    {
        const uint8_t command = *cursor++;
        const uint8_t length = *cursor++;
        const uint8_t delayMs = *cursor++;
        sendCommand(command, cursor, length);
        cursor += length;

        if (delayMs)
        {
            delay(delayMs);
        }
    }
}

void DisplayDriver::flush()
{
    if (!_canvas || !_transferBuffer)
    {
        return;
    }

    const uint16_t* source = _canvas->getFramebuffer();

    for (int landscapeX = 0; landscapeX < Width; landscapeX += TransferColumns)
    {
        const int columns = std::min(TransferColumns, Width - landscapeX);

        for (int localX = 0; localX < columns; ++localX)
        {
            for (int landscapeY = 0; landscapeY < Height; ++landscapeY)
            {
                _transferBuffer[localX * Height + (Height - landscapeY - 1)] =
                    source[landscapeY * Width + landscapeX + localX];
            }
        }

        _bus->writeC8D16D16(0x2A, 0, PanelWidth - 1);
        _bus->writeC8D16D16(
            0x2B,
            landscapeX,
            landscapeX + columns - 1);
        _bus->sendCommand(0x2C);
        _bus->writePixels(
            _transferBuffer,
            PanelWidth * columns);
    }
}
